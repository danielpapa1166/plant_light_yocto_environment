## meta-Robert-firmware/conf/layer.conf
```bitbake
# We have a conf and classes directory, add to BBPATH
BBPATH .= ":${LAYERDIR}"

# We have recipes-* directories, add to BBFILES
BBFILES += "${LAYERDIR}/recipes-*/*/*.bb \
            ${LAYERDIR}/recipes-*/*/*.bbappend"

BBFILE_COLLECTIONS += "meta-Robert-firmware"
BBFILE_PATTERN_meta-Robert-firmware = "^${LAYERDIR}/"
BBFILE_PRIORITY_meta-Robert-firmware = "6"

LAYERDEPENDS_meta-Robert-firmware = "core"
LAYERSERIES_COMPAT_meta-Robert-firmware = "kirkstone"
```

## meta-Robert/conf/layer.conf
```bitbake
# We have a conf and classes directory, add to BBPATH
BBPATH .= ":${LAYERDIR}"

# We have recipes-* directories, add to BBFILES
BBFILES += "${LAYERDIR}/recipes-*/*/*.bb \
            ${LAYERDIR}/recipes-*/*/*.bbappend"

BBFILE_COLLECTIONS += "meta-Robert"
BBFILE_PATTERN_meta-Robert = "^${LAYERDIR}/"
BBFILE_PRIORITY_meta-Robert = "6"

LAYERDEPENDS_meta-Robert = "core"
LAYERSERIES_COMPAT_meta-Robert = "kirkstone"
```

## meta-Robert/conf/machine/raspberrypi4.conf
```bitbake
# Extend the meta-raspberrypi raspberrypi4 machine configuration
require conf/machine/raspberrypi4.conf

# Add SPI kernel modules when ENABLE_SPI is set
MACHINE_ESSENTIAL_EXTRA_RRECOMMENDS += "${@oe.utils.conditional('ENABLE_SPI', '1', 'kernel-module-spi-bcm2835 kernel-module-spidev', '', d)}"
```
