/dts-v1/;
/plugin/;

&{/} {
    compatible = "brcm,bcm2711";
};

&soc {
    pwm0: pwm@fe20c000 {
        compatible = "robert,bcm2711-pwm";
        reg = <0x0 0xfe20c000 0x0 0x28>;
        #pwm-cells = <3>;
        status = "okay";
    };
};
